## layers/meta-emb-linux-logger/conf/layer.conf
```bitbake
BBPATH .= ":${LAYERDIR}"

BBFILES += "${LAYERDIR}/recipes-*/*/*.bb ${LAYERDIR}/recipes-*/*/*.bbappend"

BBFILE_COLLECTIONS += "emb-linux-logger"
BBFILE_PATTERN_emb-linux-logger = "^${LAYERDIR}/"
BBFILE_PRIORITY_emb-linux-logger = "7"

LAYERDEPENDS_emb-linux-logger = "core openembedded-layer"
LAYERSERIES_COMPAT_emb-linux-logger = "scarthgap"
```
